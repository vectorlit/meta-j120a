## conf/layer.conf
```bitbake
# We have a conf and classes directory, add to BBPATH
BBPATH .= ":${LAYERDIR}"

# We have a recipes-* directories, add to BBFILES
BBFILES += "${LAYERDIR}/recipes-*/*/*.bb \
	${LAYERDIR}/recipes-*/*/*.bbappend"

BBFILE_COLLECTIONS += "j120a"
BBFILE_PATTERN_j120a = "^${LAYERDIR}/"
BBFILE_PRIORITY_j120a = "6"
```

## conf/machine/j120a.conf
```bitbake
#@TYPE: Machine
#@NAME: j120a

#@DESCRIPTION: Machine configuration for j120a systems

PREFERRED_PROVIDER_virtual/xserver ?= "xserver-xorg"
XSERVER ?= "xserver-xorg \
           xf86-input-evdev \
           xf86-input-mouse \
           xf86-video-fbdev \
           xf86-input-keyboard"

#MACHINE_EXTRA_RRECOMMENDS = " kernel-modules kernel-devicetree"
MACHINE_EXTRA_RRECOMMENDS = " lrzsz setserial rpm minicom nano coreutils firefox mesa"

#EXTRA_IMAGEDEPENDS += "u-boot"

DEFAULTTUNE ?= "cortexa7hf-neon-vfpv4"
include conf/machine/include/tune-cortexa7.inc

IMAGE_FSTYPES += "tar.xz"

SERIAL_CONSOLE = "115200 ttySAC2"

PREFERRED_PROVIDER_virtual/kernel ?= "linux-yocto-custom"
#ASSUME_PROVIDED += " virtual/kernel"


#KERNEL_IMAGETYPE = "zImage"
#KERNEL_DEVICETREE = "am335x-bone.dtb am335x-boneblack.dtb"
#KERNEL_EXTRA_ARGS += "LOADADDR=${UBOOT_ENTRYPOINT}"

#SPL_BINARY = "MLO"
#UBOOT_SUFFIX = "img"
#UBOOT_MACHINE = "am335x_evm_config"
#UBOOT_ENTRYPOINT = "0x80008000"
#UBOOT_LOADADDRESS = "0x80008000"

MACHINE_FEATURES = " usbgadget usbhost vfat alsa bluetooth phone screen touchscreen wifi "

DISTRO_FEATURES_append = " opengl systemd pam "

#IMAGE_BOOT_FILES ?= "u-boot.${UBOOT_SUFFIX} MLO"
```
